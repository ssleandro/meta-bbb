## conf/distro/iel.conf
```bitbake
# Use O.S. Systems Embedded Linux as base
require conf/distro/oel.conf

### INOBRAM specific settings

DISTRO = "iel"
DISTRO_NAME = "Inobram Embedded Linux"

INHERIT += "ossystems-distro-version"
OSSYSTEMS_DISTRO_VERSION_DEVEL_SUFFIX = "${@'-build-%s' % BUILD_NUMBER if 'BUILD_NUMBER' in d else ''}"

INHERIT += "ossystems-srcrev-handler"
OSSYSTEMS_SRCREVS_FILE = "${PLATFORM_ROOT_DIR}/sources/meta-smaai5/conf/inobram-srcrev.conf"

TARGET_VENDOR = "-iel"
SDK_VENDOR = "-ielsdk"
SDK_VERSION := "${@'${DISTRO_VERSION}'.replace('snapshot-${DATE}','snapshot')}"

OEL_EXTRA_DISTRO_FEATURES = "\
    ext2 \
    usbgadget \
    usbhost \
"

DISTRO_FEATURES_BACKFILL_CONSIDERED += "sysvinit"

DEFAULT_TIMEZONE = "America/Sao_Paulo"

# Updatehub Settings
UPDATEHUB_PRODUCT_UID = "96c8892f54a187e2f584bde94454124ee6bcff682848ad361aa9a7b8e69e2e31"
UPDATEHUB_POLLING_INTERVAL = "1h"

PACKAGECONFIG:remove:pn-systemd = " \
    hibernate \
    ima \
    networkd \
    quotacheck \
    smack \
    xz \
"

PACKAGECONFIG:append:pn-libiio = " libiio-python3"

PACKAGECONFIG:append:pn-libgpiod = " python3"

# Openssl configure version.
# Fixed in this version to correct web-n-pro module build
PREFERRED_VERSION_openssl = "1.1.1%"

# Disable vala in the networkmanager
PACKAGECONFIG:remove:pn-networkmanager = "vala"

# Qt5 changes to use software render
PACKAGECONFIG_DISTRO:pn-qtbase = " linuxfb no-opengl xkbcommon fontconfig"
PACKAGECONFIG_GL:remove:pn-qtbase = "gles2 gbm kms"
PACKAGECONFIG_PLATFORM:remove:pn-qtbase = "eglfs"
PACKAGECONFIG_SYSTEM:append:pn-qtbase = " gif"

# Qt XML Patterns - enable QML component
PACKAGECONFIG:append:pn-qtxmlpatterns = " qtdeclarative"

PACKAGECONFIG:append:pn-sqlite3 = " readline"

SHELLHUB_TENANT_ID = "5192e230-202e-4fd8-8fa9-6f0feeaa3f87"
SHELLHUB_PRIVATE_KEY = "/data/shellhub-agent.key"
SHELLHUB_SERVER_ADDRESS = "https://shell.inobram.com.br"
```

## conf/distro/smaai5.conf
```bitbake
# Use O.S. Systems Embedded Linux as base
require conf/distro/oel.conf

### SMAAI5 specific settings

DISTRO = "smaai5"
DISTRO_NAME = "SMAAI5 Embedded Linux"

INHERIT += "ossystems-distro-version"
OSSYSTEMS_DISTRO_VERSION_DEVEL_SUFFIX = "${@'-build-%s' % BUILD_NUMBER if 'BUILD_NUMBER' in d else ''}"

INHERIT += "ossystems-srcrev-handler"
OSSYSTEMS_SRCREVS_FILE = "${PLATFORM_ROOT_DIR}/sources/meta-smaai5/conf/smaai5-srcrev.conf"

TARGET_VENDOR = "-smaai5"
SDK_VENDOR = "-smaai5sdk"
SDK_VERSION := "${@'${DISTRO_VERSION}'.replace('snapshot-${DATE}','snapshot')}"

OEL_EXTRA_DISTRO_FEATURES = "\
    ext2 \
    opengl \
    usbgadget \
    usbhost \
"

DISTRO_FEATURES_BACKFILL_CONSIDERED += "sysvinit"

DEFAULT_TIMEZONE = "America/Sao_Paulo"

# Updatehub Settings
UPDATEHUB_PRODUCT_UID = "96c8892f54a187e2f584bde94454124ee6bcff682848ad361aa9a7b8e69e2e31"
UPDATEHUB_POLLING_INTERVAL = "1h"

PACKAGECONFIG_remove_pn-systemd = " \
    backlight \
    hibernate \
    ima \
    networkd \
    quotacheck \
    smack \
    xz \
"

SHELLHUB_TENANT_ID = "3943920a-ecf3-4dd1-910b-4bf6a1186831"
SHELLHUB_PRIVATE_KEY = "/data/shellhub-agent.key"
```

## conf/layer.conf
```bitbake
# We have a conf and classes directory, add to BBPATH
BBPATH .= ":${LAYERDIR}"

# We have recipes-* directories, add to BBFILES
BBFILES += "${LAYERDIR}/recipes-*/*/*.bb \
            ${LAYERDIR}/recipes-*/*/*.bbappend"

BBFILE_COLLECTIONS += "smaai5"
BBFILE_PATTERN_smaai5 = "^${LAYERDIR}/"
BBFILE_PRIORITY_smaai5 = "10"

LAYERDEPENDS_smaai5 = "core openembedded-layer"

LAYERSERIES_COMPAT_smaai5 = "dunfell"
```

## conf/machine/ambientte-imx7d-r1.conf
```bitbake
#@TYPE: Machine
#@NAME: Ambientte
#@SOC: i.MX 7Dual
#@DESCRIPTION: Machine configuration for Ambiente - Based on Toradex Colibri iMX7 SOM (eMMC)
#@MAINTAINER: O.S. Systems Software <contato@ossystems.com.br>

MACHINEOVERRIDES =. "mx7:mx7d:"

include conf/machine/include/imx-base.inc
include conf/machine/include/tune-cortexa7.inc

MACHINE_FEATURES = "screen usbgadget usbhost ext2 touchscreen"

PREFERRED_PROVIDER_virtual/kernel = "linux-toradex-mainline"
PREFERRED_PROVIDER_virtual/dtb = "ambientte-kernel-devicetree-overlays"
KERNEL_DEVICETREE = "imx7d-colibri-emmc-eval-v3.dtb"
KERNEL_DEVICETREE_OVERLAY_PATH = "/boot/devicetree"
KERNEL_DEVICETREE_OVERLAY = "h-board-nvd-imx7.dtbo"

# The kernel lives in a seperate partition, don't deploy it in /boot/
RDEPENDS_${KERNEL_PACKAGE_NAME}-base = ""

UBOOT_MACHINE = "colibri_imx7_emmc_defconfig"
PREFERRED_PROVIDER_virtual/bootloader = "u-boot-toradex"
PREFERRED_RPROVIDER_u-boot-fw-utils = "libubootenv"
PREFERRED_PROVIDER_u-boot-default = "u-boot-updatehub-script"
PREFERRED_PROVIDER_u-boot-default-script = "u-boot-updatehub-script"
PREFERRED_PROVIDER_u-boot-mkimage-native = "u-boot-tools-native"
PREFERRED_PROVIDER_nativesdk-u-boot-mkimage = "nativesdk-u-boot-tools"

MACHINE_ESSENTIAL_EXTRA_RDEPENDS += " \
    kernel-devicetree \
    kernel-devicetree-overlays \
    kernel-image \
"

IMAGE_FSTYPES = "wic.bmap wic.xz tar.xz"
IMAGE_BOOT_FILES = "boot.scr-${MACHINE};boot.scr"
WKS_FILE_DEPENDS_append = " u-boot-default-script"
WKS_FILES = "${MACHINE}.wks"

# Qt5 settings
PREFERRED_PROVIDER_virtual/egl = "opengldummy"
PREFERRED_PROVIDER_virtual/libgles2 = "opengldummy"

# UpdateHub settings
UPDATEHUB_ACTIVE_INACTIVE_BACKEND = "u-boot"
UPDATEHUB_DEVICE_IDENTITY = "primary-iface"
UPDATEHUB_FILESYSTEM_SUPPORT = "ext4"
UPDATEHUB_IMAGE_TYPE = "active/inactive"
UPDATEHUB_INSTALL_MODE = "tarball"
UPDATEHUB_RUNTIME_PACKAGES_append = "\
    u-boot-default-env \
    u-boot-default-script \
    updatehub-config-toradex \
"

# UpdateHub Bootscript variables
UPDATEHUB_BOOTSCRIPT_LOAD_A = "\
load mmc \${devnum}:2 \${kernel_addr_r} /boot/${KERNEL_IMAGETYPE}; \
load mmc \${devnum}:2 \${fdt_addr_r} /boot/${KERNEL_DEVICETREE}; \
fdt addr \${fdt_addr_r} && fdt resize 0x20000 && \
load mmc \${devnum}:2 \${loadaddr} ${KERNEL_DEVICETREE_OVERLAY_PATH}/${KERNEL_DEVICETREE_OVERLAY} && \
fdt apply \${loadaddr} \
"
UPDATEHUB_BOOTSCRIPT_LOAD_B = "\
load mmc \${devnum}:3 \${kernel_addr_r} /boot/${KERNEL_IMAGETYPE}; \
load mmc \${devnum}:3 \${fdt_addr_r} /boot/${KERNEL_DEVICETREE}; \
fdt addr \${fdt_addr_r} && fdt resize 0x20000 && \
load mmc \${devnum}:3 \${loadaddr} ${KERNEL_DEVICETREE_OVERLAY_PATH}/${KERNEL_DEVICETREE_OVERLAY} && \
fdt apply \${loadaddr} \
"
UPDATEHUB_BOOTSCRIPT_FIND_ROOT_A = "part uuid mmc \${devnum}:2 uuid"
UPDATEHUB_BOOTSCRIPT_FIND_ROOT_B = "part uuid mmc \${devnum}:3 uuid"
UPDATEHUB_BOOTSCRIPT_BOOTARGS = "\
console=\${console},\${baudrate} root=PARTUUID=\${uuid} rootwait rw fsck.mode=force fsck.repair=yes \
"
UPDATEHUB_BOOTSCRIPT_BOOTCMD = "bootz \${kernel_addr_r} - \${fdt_addr_r}"
```

## conf/machine/smaai5-am335x.conf
```bitbake
#@TYPE: Machine
#@NAME: SMAAI5 AM335x - BeagleBone Black Machine

DEFAULTTUNE = "armv7athf-neon"

require conf/machine/include/tune-cortexa8.inc

PREFERRED_PROVIDER_virtual/kernel = "linux-beagleboard"
KBUILD_DEFCONFIG = "bb.org_defconfig"
KERNEL_DEVICETREE = "am335x-boneblack-uboot.dtb"
KERNEL_IMAGETYPE = "zImage"

PREFERRED_PROVIDER_u-boot = "u-boot-inobram"
PREFERRED_PROVIDER_virtual/bootloader = "u-boot-inobram"
PREFERRED_RPROVIDER_u-boot-fw-utils = "libubootenv-bin"
PREFERRED_RPROVIDER_u-boot-default-env = "u-boot-inobram-env"

UBOOT_ENTRYPOINT = "0x80008000"
UBOOT_LOADADDRESS = "0x80008000"

UBOOT_CONFIG = "installer emmc"
UBOOT_CONFIG[installer] = "am335x_installer_defconfig"
UBOOT_CONFIG[emmc] = "am335x_boneblack_vboot_defconfig"

UBOOT_SUFFIX = "img"
SPL_BINARY = "MLO"

SERIAL_CONSOLE = "115200 ttyS0"

MACHINE_FEATURES = " \
    apm \
    ethernet \
    ext2 \
    kernel26 \
    usbgadget \
    usbhost \
    vfat \
"

MACHINE_ESSENTIAL_EXTRA_RDEPENDS = " \
    bb-cape-overlays \
    kernel-devicetree \
    kernel-modules \
    u-boot-script-smaai5-installer \
"

WIC_CREATE_EXTRA_ARGS = "--no-fstab-update"
IMAGE_BOOT_FILES = ""
IMAGE_FSTYPES = "tar.lzma wic.bmap wic.xz"
WKS_FILE = "${MACHINE}.wks"
WKS_FILE_DEPENDS += "virtual/bootloader"

# UpdateHub Settings
UPDATEHUB_ACTIVE_INACTIVE_BACKEND = "u-boot"
UPDATEHUB_DEVICE_IDENTITY = "primary-iface"
UPDATEHUB_DEVICE_ATTRIBUTE = "ipinfo-io"
UPDATEHUB_FILESYSTEM_SUPPORT = "ext4"
UPDATEHUB_IMAGE_TYPE = "active/inactive"
UPDATEHUB_INSTALL_MODE = "tarball raw"
```

## wic/ambientte-imx7d-r1-installer.wks
```
part /boot --source bootimg-partition --ondisk mmcblk --fstype=ext4 --label boot --active --align 4096 --fixed-size 5M --extra-space 0
part / --source rootfs --ondisk mmcblk --fstype=ext4 --label root --align 4096

bootloader --ptable msdos
```

## wic/ambientte-imx7d-r1.wks
```
part /boot --source bootimg-partition --ondisk mmcblk --fstype=ext4 --label boot --active --align 4096 --fixed-size 5M --extra-space 0
part / --source rootfs --ondisk mmcblk --fstype=ext4 --label system_a  --align 4096 --fixed-size 1024M --extra-space 0
part / --source rootfs --ondisk mmcblk --fstype=ext4 --label system_b  --align 4096 --fixed-size 1024M --extra-space 0
part /data --ondisk mmcblk --fstype=ext4 --label data --align 4096 --fixed-size 512M --extra-space 0

bootloader --ptable msdos
```

## wic/smaai5-am335x-installer.wks
```
part u-boot-env --source rawcopy --sourceparams="file=uboot-empty-config" --ondisk mmcblk --no-table --align 4
part MLO --source rawcopy --sourceparams="file=MLO-installer" --ondisk mmcblk --no-table --align 128
part u-boot --source rawcopy --sourceparams="file=u-boot.img-installer" --ondisk mmcblk --no-table --align 384
part / --source rootfs --ondisk mmcblk --fstype=ext4 --label rootfs --align 1024

bootloader --ptable msdos
```

## wic/smaai5-installer.wks
```
part MLO --source rawcopy --sourceparams="file=MLO" --ondisk mmcblk --no-table --align 128
part u-boot --source rawcopy --sourceparams="file=u-boot.img" --ondisk mmcblk --no-table --align 384
part / --source rootfs --ondisk mmcblk --fstype=ext4 --label rootfs --align 1024

bootloader --ptable msdos
```

## wic/smaai5.wks
```
part MLO --source rawcopy --sourceparams="file=MLO" --ondisk mmcblk --no-table --align 128
part u-boot --source rawcopy --sourceparams="file=u-boot.img" --ondisk mmcblk --no-table --align 384
part / --source rootfs --ondisk mmcblk --fstype=ext4 --label system_a  --align 1024 --fixed-size 1700M --extra-space 0
part / --source rootfs --ondisk mmcblk --fstype=ext4 --label system_b  --align 1024 --fixed-size 1700M --extra-space 0
part /data --ondisk mmcblk --fstype=ext4 --label data --align 1024 --fixed-size 200M --extra-space 0

bootloader --ptable msdos
```
